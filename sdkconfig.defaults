## sdkconfig.defaults
```kconfig
CONFIG_LV_MEM_CUSTOM=y
CONFIG_LV_MEMCPY_MEMSET_STD=y
CONFIG_LV_USE_USER_DATA=y
CONFIG_LV_USE_CHART=y
CONFIG_LV_USE_PERF_MONITOR=y
CONFIG_ESP_WIFI_SOFTAP_SUPPORT=n
# Example Configuration
#
CONFIG_ESP_WIFI_SSID="myssid"
CONFIG_ESP_WIFI_PASSWORD="mypassword"
# CONFIG_ESP_WPA3_SAE_PWE_HUNT_AND_PECK is not set
# CONFIG_ESP_WPA3_SAE_PWE_HASH_TO_ELEMENT is not set
CONFIG_ESP_WPA3_SAE_PWE_BOTH=y
CONFIG_ESP_WIFI_PW_ID=""
CONFIG_ESP_MAXIMUM_RETRY=5
# CONFIG_ESP_WIFI_AUTH_OPEN is not set
# CONFIG_ESP_WIFI_AUTH_WEP is not set
# CONFIG_ESP_WIFI_AUTH_WPA_PSK is not set
CONFIG_ESP_WIFI_AUTH_WPA2_PSK=y
# CONFIG_ESP_WIFI_AUTH_WPA_WPA2_PSK is not set
# CONFIG_ESP_WIFI_AUTH_WPA3_PSK is not set
# CONFIG_ESP_WIFI_AUTH_WPA2_WPA3_PSK is not set
# CONFIG_ESP_WIFI_AUTH_WAPI_PSK is not set
# end of Example Configuration
```

## sdkconfig.defaults.esp32s3
```kconfig
CONFIG_SPIRAM=y
CONFIG_SPIRAM_MODE_OCT=y
CONFIG_SPIRAM_SPEED_80M=y

# Enabling the following configurations can help increase the PCLK frequency in the case when
# the Frame Buffer is allocated from the PSRAM and fetched by EDMA
CONFIG_SPIRAM_FETCH_INSTRUCTIONS=y
CONFIG_SPIRAM_RODATA=y
CONFIG_ESP_WIFI_SSID="myssid"
CONFIG_ESP_WIFI_PASSWORD="mypassword"
# CONFIG_ESP_WPA3_SAE_PWE_HUNT_AND_PECK is not set
# CONFIG_ESP_WPA3_SAE_PWE_HASH_TO_ELEMENT is not set
CONFIG_ESP_WPA3_SAE_PWE_BOTH=y
CONFIG_ESP_WIFI_PW_ID=""
CONFIG_ESP_MAXIMUM_RETRY=5
# CONFIG_ESP_WIFI_AUTH_OPEN is not set
# CONFIG_ESP_WIFI_AUTH_WEP is not set
# CONFIG_ESP_WIFI_AUTH_WPA_PSK is not set
CONFIG_ESP_WIFI_AUTH_WPA2_PSK=y
# CONFIG_ESP_WIFI_AUTH_WPA_WPA2_PSK is not set
# CONFIG_ESP_WIFI_AUTH_WPA3_PSK is not set
# CONFIG_ESP_WIFI_AUTH_WPA2_WPA3_PSK is not set
# CONFIG_ESP_WIFI_AUTH_WAPI_PSK is not set
```
